## boards/weact/blackpill_f411ce_8mhz/Kconfig.blackpill_f411ce_8mhz
```kconfig
# Copyright (c) 2020 Brian Bradley
# SPDX-License-Identifier: Apache-2.0

config BOARD_BLACKPILL_F411CE_8MHZ
	select SOC_STM32F411XE
```

## boards/weact/blackpill_f411ce_8mhz/board.yml
```yaml
board:
  name: blackpill_f411ce_8mhz
  full_name: Black Pill V3.1 (8MHz)
  vendor: weact
  socs:
    - name: stm32f411xe
```

## boards/weact/stm32f103vet6/Kconfig.stm32f103vet6
```kconfig
# SPDX-License-Identifier: Apache-2.0

config BOARD_STM32F103VET6
	select SOC_STM32F103XE
```

## boards/weact/stm32f103vet6/board.yml
```yaml
board:
  name: stm32f103vet6
  full_name: Weact STM32F103VET6
  vendor: weact
  socs:
    - name: stm32f103xe
```
